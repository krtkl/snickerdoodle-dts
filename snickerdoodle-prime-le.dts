/**
 * Copyright (c) 2016 krtkl inc.
 *
 * snickerdoodle prime le base device tree source
 *
 * This program is free software; you can redistribute it and/or modify it
 * under the terms of the GNU General Public License version 2 as published by
 * the Free Software Foundation.
 */

/dts-v1/;
/include/ "snickerdoodle-prime-le.dtsi"

/ {
	model = "snickerdoodle prime le";
};
