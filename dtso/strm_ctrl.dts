/**
 * Copyright (c) 2016 krtkl inc.
 *
 * UIO device tree overlay
 *
 * This program is free software; you can redistribute it and/or modify it
 * under the terms of the GNU General Public License version 2 as published by
 * the Free Software Foundation.
 */

/dts-v1/;
/plugin/;

/ {
	compatible = "xlnx,zynq-snickerdoodle", "xlnx,zynq-7000";

	fragment@0 {
		target-path = "/";
		__overlay__ {
			
			#address-cells = <1>;
			#size-cells = <1>;

			strm_ctrl: strm_ctrl@43c00000 {
				compatible = "krtkl,generic-uio,ui_pdrv";
				reg = <0x43c00000 0x10000>;
				interrupt-parent = <&intc>;
				interrupts = <0 29 4>;
			};
		};
	};

	fragment@1 {
		target-path = "\__symbols__";
		__overlay__ {
			strm_ctrl = &strm_ctrl;
		};
	};
};
