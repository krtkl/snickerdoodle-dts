/**
 * Copyright (c) 2016 krtkl inc.
 *
 * UIO device tree overlay
 *
 * This program is free software; you can redistribute it and/or modify it
 * under the terms of the GNU General Public License version 2 as published by
 * the Free Software Foundation.
 */

/dts-v1/;
/plugin/;

/ {
	compatible = "xlnx,zynq-snickerdoodle", "xlnx,zynq-7000";

	fragment@0 {
		target-path = "/";
		__overlay__ {
			
			#address-cells = <1>;
			#size-cells = <1>;

			axi_gpio0: gpio@41200000 {
//				compatible = "xlnx,xps-gpio-1.00.a";
//				gpio-controller;
//				#gpio-cells = <2>;
//				#address-cells = <2>;
//				#size-cells = <1>;
				reg = <0x41200000 0x10000>;
//				xlnx,is-dual = <0>;
//				xlnx,all-inputs = <1>;
//				xlnx,gpio-width = <1>;
				compatible = "krtkl,generic-uio,ui_pdrv";
				interrupt-parent = <&intc>;
				interrupts = <0 29 4>;
			};
		};
	};

	fragment@1 {
		target-path = "\__symbols__";
		__overlay__ {
			axi_gpio0 = &axi_gpio0;
		};
	};
};
