/**
 * Copyright (c) 2016 krtkl inc.
 *
 * snickerdoodle I2C include device tree source
 *
 * This program is free software; you can redistribute it and/or modify it
 * under the terms of the GNU General Public License version 2 as published by
 * the Free Software Foundation.
 */

&i2c1 {
	status = "okay";
	clock-frequency = <100000>;
};
