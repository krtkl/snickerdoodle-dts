/**
 * Copyright (c) 2018 krtkl inc.
 *
 * snickerdoodle SPI Device Tree Overlay
 *
 * This program is free software; you can redistribute it and/or modify it
 * under the terms of the GNU General Public License version 2 as published by
 * the Free Software Foundation.
 */

/dts-v1/;
/plugin/;

/ {
	fragment@0 {
		target = <&spi0>;
		__overlay__ {
			status = "okay";
			num-cs = <1>;
			is-decoded-cs = <0>;
			#address-cells = <1>;
			#size-cells = <0>;

			spidev@0 {
				compatible = "linux,spidev";
				reg = <0>;
				spi-max-frequency = <1000000>;
			};
		};
	};
};

