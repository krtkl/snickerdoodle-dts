/**
 * Copyright (c) 2016 krtkl inc.
 *
 * snickerdoodle prime LE base device tree source
 *
 * This program is free software; you can redistribute it and/or modify it
 * under the terms of the GNU General Public License version 2 as published by
 * the Free Software Foundation.
 */

/include/ "snickerdoodle.dtsi"
/ {
        compatible = "xlnx,zynq-snickerdoodle-prime-le", "xlnx,zynq-snickerdoodle", "xlnx,zynq-7000";

	memory@0 {
		device_type = "memory";
		reg = <0x0 0x20000000>;
	};
};

&wlcore {
	compatible = "wlcore", "ti,wl1801";
};
