/**
 * Copyright (c) 2017 krtkl inc.
 *
 * snickerdoodle One base device tree source
 *
 * This program is free software; you can redistribute it and/or modify it
 * under the terms of the GNU General Public License version 2 as published by
 * the Free Software Foundation.
 */

/include/ "snickerdoodle.dtsi"
/ {
        model = "snickerdoodle One";
        compatible = "krtkl,snickerdoodle-one", "krtkl,snickerdoodle", "xlnx,zynq-7000";

	memory@0 {
		device_type = "memory";
		reg = <0x0 0x20000000>;
	};
};

&wlcore {
	compatible = "wlcore", "ti,wl1801";
};
